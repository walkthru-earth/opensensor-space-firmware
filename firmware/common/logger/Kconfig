## firmware/common/logger/Kconfig
```kconfig
menu "OpenSensor logger storage worker"

config OS_LOGGER_WORKER_WDT
    bool "Reset the chip when the storage worker stalls"
    depends on ESP_TASK_WDT_EN
    default y
    help
        Registers the parquet-sd worker as a task watchdog user. The worker
        feeds it at every heartbeat stamp, and a 1 s supervisor timer feeds it
        on the worker's behalf while the heartbeat is younger than
        OS_LOGGER_WORKER_WDT_TIMEOUT_S. After that the task watchdog panics,
        names parquet-sd and resets with a core dump when the image enables
        one. A worker that moves again before that period ends is recovered,
        and the original task watchdog config is restored. Three such resets
        without a healthy period in between switch the worker to warn-only
        until it stays healthy again.

config OS_LOGGER_WORKER_WDT_TIMEOUT_S
    int "Storage worker stall timeout (seconds)"
    depends on OS_LOGGER_WORKER_WDT
    range 15 600
    default 60
    help
        Heartbeat age that counts as a stall. The reset follows within one
        more ESP_TASK_WDT_TIMEOUT_S period. A single SD call between two
        heartbeat stamps, such as the first free-cluster count of a large
        FAT volume, must finish within this time.

config OS_LOGGER_WORKER_WDT_HEALTHY_S
    int "Healthy period that clears the stall reset count (seconds)"
    depends on OS_LOGGER_WORKER_WDT
    range 60 86400
    default 3600
    help
        Continuous time without an expired heartbeat after which the
        consecutive stall reset count returns to zero and a warn-only worker
        is armed again.

config OS_LOGGER_BENCH_STALL
    bool "Bench only, the parquet bench-stall serial command"
    default n
    help
        Adds the serial command `parquet bench-stall <s>`, which blocks the
        storage worker for s seconds (1 to 3600) without stamping its
        heartbeat, or forever when s is 0. It prints
        `PARQUET BENCH stall_s=<s>` first and `PARQUET BENCH stall-end` when
        a returning stall ends. Use it to force the worker watchdog, its
        recovery and a core dump on a bench board. Turn it on only through
        tools/idf-bench-stall-sdkconfig.defaults in a separate build
        directory. Never ship an image with it, any serial user can stop
        logging with it.

config OS_LOGGER_FLASH_FALLBACK
    bool "Mount the internal flash volume for cardless logging"
    default n
    help
        The board mounts the data partition labelled spiffs at /flash through
        wear levelling at boot and passes /flash/output to the logger as its
        fallback archive root (decision record 0004). The volume is formatted
        at most once in the life of the board, and NVS osflash/formatted
        records that format. After it is set a failed mount leaves the volume
        off and is never formatted again. Boot prints one
        `OS FLASH mount ok=...` line. The partition table stays as it is.

endmenu
```
